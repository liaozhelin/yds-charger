## 3.Software/yds_charger/components/lis3dh/Kconfig.projbuild
```kconfig
menu "LIS3DH Component Config"
    choice U8G2_INIT_I2C_CONTROL
        prompt "Select ENABLE I2C interface (When there are not only one drivers on lines)"
        default LIS3DH_INIT_I2C_ENABLE

        config LIS3DH_INIT_I2C_ENABLE
            bool "ENABLE"
        config LIS3DH_INIT_I2C_DISABLE
            bool "DISABLE"
    endchoice

    config LIS3DH_I2C_ADDRESS
        hex "LIS3DH Device I2C address (hex, 7bit)"
        default 0x19

    config LIS3DH_I2C_PERIPH_NUM
        int "I2C Peripheral number"
        default 0
        depends on LIS3DH_INIT_I2C_ENABLE

    config LIS3DH_I2C_SDA_PIN
        int "I2C SDA GPIO pin number"
        default 25
        depends on LIS3DH_INIT_I2C_ENABLE
    
    config LIS3DH_I2C_SCL_PIN
        int "I2C SCL GPIO pin number"
        default 26
        depends on LIS3DH_INIT_I2C_ENABLE

    config LIS3DH_I2C_SPEED
        int "I2C clock frequency"
        default 400000
        depends on LIS3DH_INIT_I2C_ENABLE
    
endmenu
```

## 3.Software/yds_charger/components/u8g2/Kconfig.projbuild
```kconfig
menu "U8G2 Component Config"
    choice U8G2_INIT_I2C_CONTROL
        prompt "Select ENABLE I2C interface (When there are not only one drivers on lines)"
        default LIS3DH_INTERFACE_I2C

        config U8G2_INIT_I2C_ENABLE
            bool "ENABLE"
        config U8G2_INIT_I2C_DISABLE
            bool "DISABLE"
    endchoice

    config U8G2_I2C_ADDRESS
        hex "OLED Device I2C address (hex, 7bit)"
        default 0X78
            
    config U8G2_I2C_PERIPH_NUM
        int "I2C Peripheral number"
        default 0
            
    config U8G2_I2C_SPEED
        int "I2C clock frequency"
        default 400000
        depends on U8G2_INIT_I2C_ENABLE

    config U8G2_I2C_SCL
        int "I2C SCL GPIO pin number"
        default 2
        depends on U8G2_INIT_I2C_ENABLE

    config U8G2_I2C_SDA
        int "I2C SDA GPIO pin number"
        default 3
        depends on U8G2_INIT_I2C_ENABLE

endmenu
```

## 3.Software/yds_charger/components/wifi/Kconfig.projbuild
```kconfig
menu "Wifi Component Config"

    config ESP_WIFI_SSID
        string "ESP_WIFI_SSID"
        default "205"
        help
            SSID (network name) for the system to connect to.

    config ESP_WIFI_PASSWORD
        string "ESP_WIFI_PASSWORD"
        default "a12345678."
        help
            WiFi password (WPA or WPA2) for the system to use.

    config ESP_MAXIMUM_RETRY
        int "Maximum retry"
        default 5
        help
            Set the Maximum retry to avoid station reconnecting to the AP unlimited when the AP is really inexistent.
endmenu
```
